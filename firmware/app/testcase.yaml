## firmware/app/testcase.yaml
```yaml
tests:
  cloudsense.app.smoke:
    tags: cloudsense
    platform_allow: native_sim
    harness: console
    harness_config:
      type: multi_line # all lines below must be present in the output
      regex:
        - "Hello from CloudSense!"
        - "Temperature: 25.000000 C"
    timeout: 3 # seconds
```

## firmware/drivers/sensor/dummy_sensor/Kconfig
```kconfig
config CUSTOM_SIMULATED_SENSOR
    bool "CloudSense Simulated Sensor"
    default y
    depends on DT_HAS_CLOUDSENSE_SIMULATED_SENSOR_ENABLED
    select SENSOR
    help
      Enable support for the CloudSense simulated temperature sensor.
```

## firmware/testcase.yaml
```yaml
tests:
  cloudsense.smoke:
    tags: cloudsense
    platform_allow: native_sim
    harness: console
    harness_config:
      type: multi_line # all lines below must be present in the output
      regex:
        - "Hello from CloudSense!"
        - "Temperature: 25.000000 C"
        - "Heartbeat: [0-9]+ ms"
    timeout: 3
```

## firmware/tests/drivers/sensor/dummy_sensor/testcase.yaml
```yaml
tests:
  cloudsense.drivers.sensor.simulated_sensor:
    tags:
      - cloudsense
      - drivers
      - sensor
    platform_allow:
      - native_sim
```
