## CMakeLists.txt
```
cmake_minimum_required(VERSION 3.20.0)
find_package(Zephyr REQUIRED HINTS $ENV{ZEPHYR_BASE})
project(cloudsense_firmware)    

add_subdirectory(drivers)

target_sources(app PRIVATE src/main.c)
```

## Kconfig
```
# menu "Zephyr Kernel"
#     source "Kconfig.zephyr"
# endmenu

menu "CloudSense"
    rsource "drivers/Kconfig"
endmenu
```

## west.yml
```
manifest:
  self:
    path: app

  remotes:
    - name: zephyrproject-rtos
      url-base: https://github.com/zephyrproject-rtos

  projects:
    - name: zephyr
      remote: zephyrproject-rtos
      revision: v4.4.0
      import:
        name-allowlist:
          - cmsis
```

## prj.conf
```kconfig
CONFIG_GPIO=y
CONFIG_PRINTK=y

CONFIG_SENSOR=y
CONFIG_CUSTOM_DUMMY_SENSOR=y
```

## boards/native_sim.overlay
```dts
/ {
    aliases {
        temp-sensor = &dummy_sensor;
    };

    dummy_sensor: dummy_sensor {
        compatible = "cloudsense,dummy-sensor";
        status = "okay";
    };
};
```

## dts/bindings/sensor/cloudsense,dummy-sensor.yaml
```yaml
description: CloudSense Dummy Sensor
compatible: "cloudsense,dummy-sensor"
include: sensor-device.yaml
```

## dts/bindings/sensor/cloudsense,simulated-sensor.yaml
```yaml
description: CloudSense Simulated Sensor
compatible: "cloudsense,simulated-sensor"
include: sensor-device.yaml

properties:
  base-temp:
    type: int
    required: false
    default: 25
    description: Base temperature in degrees Celsius
```

## src/main.c
```c
#include <zephyr/kernel.h>
#include <zephyr/sys/printk.h>

int main(void) {
    printk("Hello from CloudSense!\n");

    while (1) {
        printk("Heartbeat: %lld ms\n", k_uptime_get());
        k_msleep(1000);
    }

    return 0;
}
```
