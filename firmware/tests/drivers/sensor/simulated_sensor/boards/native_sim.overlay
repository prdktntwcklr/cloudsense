/ {
    aliases {
        simulated = &simulated_sensor;
    };
};

/ {
    simulated_sensor: simulated_sensor {
        compatible = "cloudsense,simulated-sensor";
        status = "okay";
        base-temp = <42>;
    };
};
